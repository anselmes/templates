## CMakeLists.txt
```
# ==============================================================================
# HELLO PROJECT CMAKE CONFIGURATION
# ==============================================================================
# This CMake build file configures a Zephyr RTOS embedded project with Swift
# language support. It handles the integration between Swift compiler settings
# and Zephyr's build system for embedded development.
# ==============================================================================

cmake_minimum_required(VERSION 3.29)

# ==== Environment Configuration ====
# Retrieve build configuration from environment variables
set(BOARD $ENV{ZEPHYR_BOARD})                                 # Target board for the application
set(BUILD_TARGET $ENV{ZEPHYR_BUILD_TARGET})                   # Target triple (e.g., arm-none-eabi)
set(CROSS_COMPILE $ENV{CROSS_COMPILE})                        # Cross-compiler prefix
set(DTC_OVERLAY_FILE $ENV{ZEPHYR_BOARD_OVERLAY})              # Device Tree overlay file
set(SYSROOT_DIR $ENV{SYSROOT_DIR})                            # Sysroot directory for cross-compilation
set(ZEPHYR_TOOLCHAIN_VARIANT $ENV{ZEPHYR_TOOLCHAIN_VARIANT})  # Toolchain variant name

# ==== Zephyr Integration ====
# Find and include Zephyr RTOS package
# This initializes Zephyr's build system and makes its build targets available
find_package(Zephyr REQUIRED HINTS $ENV{ZEPHYR_BASE})

# ==== Swift Configuration ====
# Configure Swift compiler settings
set(CMAKE_Swift_COMPILER_TARGET ${BUILD_TARGET})        # Set target triple for Swift compiler
set(CMAKE_Swift_COMPILATION_MODE wholemodule)           # Enable whole-module optimization (WMO) required by Embedded Swift
set(CMAKE_Swift_COMPILER_WORKS true)                    # Explicitly indicate Swift compiler is functional

# Define the project with Swift language support
project(zephyr_swift_template)
enable_language(Swift)

# ==== Compiler Flags ====
# Set global Swift compiler flags
# These flags enable embedded development features and configure optimizations
add_compile_options(
  "$<$<COMPILE_LANGUAGE:Swift>:SHELL:-enable-experimental-feature Embedded>"          # Enable Swift for embedded systems feature
  "$<$<COMPILE_LANGUAGE:Swift>:SHELL:-Xfrontend -function-sections>"                  # Place each function in its own section for better link-time optimization
  "$<$<COMPILE_LANGUAGE:Swift>:SHELL:-Xfrontend -enable-single-module-llvm-emission>" # Generate single LLVM module
)

# ==== Zephyr Definitions Propagation ====
# Add definitions from Zephyr to -Xcc flags
# This ensures Swift code has access to all Zephyr-defined macros
# get_target_property(ZEPHYR_DEFINES zephyr_interface INTERFACE_COMPILE_DEFINITIONS)
# if(ZEPHYR_DEFINES)
#   foreach(flag ${ZEPHYR_DEFINES})
#     # Ignore expressions like "$<SOMETHING>" which are CMake generator expressions
#     string(FIND "${flag}" "$<" start_of_expression)
#     if(NOT start_of_expression EQUAL -1)
#       continue()
#     endif()
#     add_compile_options("$<$<COMPILE_LANGUAGE:Swift>:SHELL:-Xcc -D${flag}>")
#   endforeach()
# endif()

# ==== C Support Files ====
# Add C stubs required for Swift/C interoperability
target_sources(app PRIVATE src/Stubs.c)  # Include C stubs for bridging Swift and C.

# ==== Swift Library Configuration ====
# Create an OBJECT library for Swift main source file
# OBJECT library ensures the Swift main function is linked correctly
# Zephyr provides a default weak main definition, which would drop a STATIC library from linking
add_library(${PROJECT_NAME} OBJECT
  src/Main.swift       # Main application entry point
  lib/Time.swift       # Time-related utilities
)

# ==== Build Dependencies ====
# Ensure syscall headers are generated before compiling Swift sources
# This is crucial as Swift code might depend on these generated headers.
add_dependencies(${PROJECT_NAME} syscall_list_h_target)

# ==== Swift Include Directories ====
# Set implicit include directories for Swift
# These directories are automatically included in the Swift compilation process
# This is necessary to ensure Swift can find all required headers.
# set(SWIFT_INCLUDES)
# foreach(dir ${CMAKE_C_IMPLICIT_INCLUDE_DIRECTORIES})
#     string(CONCAT SWIFT_INCLUDES ${SWIFT_INCLUDES} "-Xcc ")
#     string(CONCAT SWIFT_INCLUDES ${SWIFT_INCLUDES} "-I${dir} ")
# endforeach()
# foreach(dir ${CMAKE_CXX_IMPLICIT_INCLUDE_DIRECTORIES})
#     string(CONCAT SWIFT_INCLUDES ${SWIFT_INCLUDES} "-Xcc ")
#     string(CONCAT SWIFT_INCLUDES ${SWIFT_INCLUDES} "-I${dir} ")
# endforeach()

# ==== Swift-Specific Compiler Options ====
# Add specific compile options for Swift language
target_compile_options(${PROJECT_NAME} PRIVATE
  "$<$<COMPILE_LANGUAGE:Swift>:SHELL:-parse-as-library>"  # Process Swift files as libraries rather than executables
  "$<$<COMPILE_LANGUAGE:Swift>:SHELL:-Osize>"             # Optimize for binary size (important for embedded)
  # "$<$<COMPILE_LANGUAGE:Swift>:SHELL:${SWIFT_INCLUDES}>"  # Include directories for Swift compilation
  "$<$<COMPILE_LANGUAGE:Swift>:SHELL:-import-bridging-header ${CMAKE_CURRENT_LIST_DIR}/include/BridgingHeader.h>" # Bridge to C APIs
)

# ==== Include Directories ====
# Copy include directories from the C target (app) to the Swift target
# This makes Zephyr's and application's C headers available to Swift.
target_include_directories(${PROJECT_NAME} PRIVATE "$<TARGET_PROPERTY:app,INCLUDE_DIRECTORIES>")

# ==== Linking ====
# Link the Swift OBJECT library into the primary Zephyr application target
# This integrates the compiled Swift code into the final application.
target_link_libraries(app PRIVATE ${PROJECT_NAME})

# ==== Post-Build Processing ====
# Post-build step: Remove the .swift_modhash section from the final binary
# The .swift_modhash section is used for incremental compilation but is not needed in the final embedded binary.
# Removing it reduces binary size and removes unnecessary metadata.
add_custom_command(TARGET app POST_BUILD
  COMMAND ${CMAKE_OBJCOPY} --remove-section .swift_modhash $<TARGET_FILE:app> $<TARGET_FILE:app>
  COMMENT "Removing .swift_modhash section from final binary"
)
```

## prj.conf
```kconfig
# ==============================================================================
# PROJECT CONFIGURATION FILE
# ==============================================================================
# This file contains Kconfig configuration options for the Zephyr RTOS project.
# These settings control various system behaviors, libraries, and build options.
# ==============================================================================

# ==== System Configuration ====

# Enable static initialization for GNU toolchain.
# This configuration ensures that static constructors and destructors
# are properly initialized when using the GNU toolchain.
CONFIG_STATIC_INIT_GNU=y

# Enable console output to be directed to standard output.
# This allows debug messages and application output to be visible.
CONFIG_STDOUT_CONSOLE=y

# ==== Library Configuration ====

# Enable the Newlib C standard library implementation.
# Newlib provides standard C library functions suitable for embedded systems.
# CONFIG_NEWLIB_LIBC=y

# ==== Boot Configuration ====

# Enable MCUboot bootloader support.
# MCUboot is a secure bootloader designed for microcontroller-based systems.
# Uncomment the following line to enable MCUboot integration.
# CONFIG_BOOTLOADER_MCUBOOT=y

# ==== Build Output Configuration ====

# Enable generation of a HEX file as a build output.
# This is useful for programming the device with common flashing tools.
# CONFIG_BUILD_OUTPUT_HEX=y
```

## include/BridgingHeader.h
```c
// Copyright (c) 2025 Schubert Anselme <schubert@anselm.es>
// SPDX-Licence-Identifier: GPL-3.0

/**
 * @file BridgingHeader.h
 * @brief Common header for Zephyr and Embedded Swift integration.
 *
 * This header includes project configuration and Zephyr kernel, device, and GPIO APIs,
 * and declares utility functions for GPIO access used across the project.
 */

#pragma once

// Project configuration header
#include <autoconf.h>

// Zephyr kernel APIs
#include <zephyr/kernel.h>
```

## src/Stubs.c
```c
// SPDX-Licence-Identifier: GPL-3.0

/**
 * @file Stubs.c
 * @brief Stub implementations for missing C library functions in Zephyr SDK.
 *
 * This file provides stub implementations for functions required by Embedded Swift
 * that are not available in the Zephyr SDK's C libraries. These stubs enable
 * Swift code to compile and run correctly on Zephyr RTOS by filling gaps in
 * the C runtime environment expected by Swift.
 *
 * Current implementations:
 * - posix_memalign: Memory allocation with alignment requirements
 * - getentropy: Random bytes generation (non-cryptographic implementation)
 */

#include <errno.h>
#include <stddef.h>
#include <stdint.h>
#include <stdlib.h>

/**
 * @brief Allocates memory with the specified alignment.
 *
 * This is a forward declaration for aligned_alloc, which allocates size bytes
 * of uninitialized storage whose alignment is specified by alignment.
 * This function is required for the stub implementation of posix_memalign.
 *
 * @param alignment The alignment value, which must be a power of two and a multiple of sizeof(void *).
 * @param size      The size of the memory block to allocate.
 * @return          A pointer to the allocated memory, or NULL if the allocation fails.
 *
 * @note The actual implementation is provided by the Zephyr C library.
 */
void *aligned_alloc(size_t alignment, size_t size);

/**
 * @brief Allocates memory with the specified alignment using posix_memalign interface.
 *
 * This function implements posix_memalign by forwarding the allocation request to aligned_alloc.
 * It is provided as a stub for environments where posix_memalign is not available, such as the Zephyr SDK.
 * Swift's memory allocator may call this function when it needs to allocate aligned memory blocks.
 *
 * @param[out] memptr    Pointer to the allocated memory block (output parameter).
 * @param[in]  alignment The alignment value, which must be a power of two and a multiple of sizeof(void *).
 * @param[in]  size      The size of the memory block to allocate.
 *
 * @return 0 on successful allocation, or an error code (errno) on failure.
 */
int posix_memalign(void **memptr, const size_t alignment, const size_t size)
{
  // Attempt to allocate memory with the specified alignment and size
  void *p = aligned_alloc(alignment, size);

  if (p)
  {
    // Allocation succeeded, set the output pointer and return success
    *memptr = p;
    return 0;
  }

  // Allocation failed, return the error code stored in errno
  return errno;
}

/**
 * @brief Stub implementation of getentropy.
 *
 * This function fills a buffer with random bytes. Since Zephyr may not provide
 * a native getentropy, this stub uses rand() as a fallback.
 *
 * @warning This implementation is NOT cryptographically secure and should not be
 *          used for security-sensitive operations. It's provided only to satisfy
 *          Swift runtime dependencies in non-security-critical applications.
 *
 * @param buffer Pointer to the buffer to fill with random bytes.
 * @param length Number of bytes to generate (limited to 256 bytes per POSIX spec).
 *
 * @return 0 on success, -1 on failure with errno set to indicate the error.
 */
int getentropy(void *buffer, size_t length)
{
  // Validate input parameters:
  // - buffer must not be NULL
  // - length must not exceed 256 (POSIX specification limit)
  if (!buffer || length > 256) {
    errno = EINVAL;  // Set invalid argument error code
    return -1;
  }

  // Fill the buffer with pseudo-random bytes
  unsigned char *buf = (unsigned char *)buffer;
  for (size_t i = 0; i < length; i++) {
    // Generate a random byte (0-255) using rand()
    // Note: rand() is not suitable for cryptographic purposes
    buf[i] = rand() % 256;
  }

  return 0;  // Success
}
```
