## prj.conf
```kconfig
# ==============================================================================
# PROJECT CONFIGURATION FILE
# ==============================================================================
# This file contains Kconfig configuration options for the Zephyr RTOS project.
# These settings control various system behaviors, libraries, and build options.
# ==============================================================================

# ==== System Configuration ====

# Enable static initialization for GNU toolchain.
# This configuration ensures that static constructors and destructors
# are properly initialized when using the GNU toolchain.
CONFIG_STATIC_INIT_GNU=y

# Enable console output to be directed to standard output.
# This allows debug messages and application output to be visible.
CONFIG_STDOUT_CONSOLE=y

# ==== Library Configuration ====

# Enable the Newlib C standard library implementation.
# Newlib provides a more complete set of standard C library functions
# and is suitable for embedded systems requiring advanced features.
CONFIG_NEWLIB_LIBC=y

# Enable the minimal C library implementation.
# This is a lightweight C library suitable for embedded systems with limited resources.
CONFIG_MINIMAL_LIBC=y

# Disable Picolibc to avoid conflicts with Newlib.
# Picolibc is another C library implementation, but it cannot be used
# simultaneously with Newlib in this configuration.
CONFIG_PICOLIBC=n

# ==== Boot Configuration ====

# Enable MCUboot bootloader support.
# MCUboot is a secure bootloader designed for microcontroller-based systems.
# Uncomment the following line to enable MCUboot integration.
# CONFIG_BOOTLOADER_MCUBOOT=y

# ==== Build Output Configuration ====

# Enable generation of a HEX file as a build output.
# This is useful for programming the device with common flashing tools.
# Uncomment the following line to enable HEX file generation.
# CONFIG_BUILD_OUTPUT_HEX=y
```

## include/BridgingHeader.h
```c
// Copyright (c) 2025 Schubert Anselme <schubert@anselm.es>
// SPDX-Licence-Identifier: GPL-3.0

/**
 * @file BridgingHeader.h
 * @brief Common header for Zephyr and Embedded Swift integration.
 *
 * This header serves as the bridging interface between Swift and C code in the project.
 * It includes necessary Zephyr RTOS headers to make Zephyr functionality available
 * to Swift code through C interoperability. The Swift compiler processes this header
 * when the '-import-bridging-header' flag is used during compilation.
 *
 * Headers are organized into logical groups:
 * - Project configuration: Generated by Zephyr build system
 * - Kernel APIs: Core Zephyr kernel functionality
 * - Device APIs: Hardware access and management
 * - GPIO APIs: General purpose I/O control
 */

#pragma once

// ===== Project Configuration =====
// Include auto-generated configuration header
// This file is generated by Kconfig during the build process and contains
// all the project configuration settings from prj.conf
#include <autoconf.h>

// ===== Zephyr Kernel APIs =====
// Core kernel functionality including scheduling, threading, and synchronization
#include <zephyr/kernel.h>

// ===== Device and Hardware APIs =====
// Generic device model interfaces for hardware access
#include <zephyr/device.h>
// GPIO interfaces for pin control and interrupts
#include <zephyr/drivers/gpio.h>

// ===== C Function Declarations =====
/**
 * @brief Get the GPIO device instance for the specified port
 *
 * Retrieves the Zephyr device structure for the requested GPIO port.
 * This function provides a simplified interface for Swift code to access GPIO devices.
 *
 * @param port_name Name of the GPIO port (e.g., "GPIO_0", "GPIO_1")
 * @return Pointer to the GPIO device, or NULL if the device is not found
 */
const struct device *get_gpio_device(const char *port_name);

/**
 * @brief Configure a GPIO pin for the specified direction and flags
 *
 * Sets up a GPIO pin with the specified configuration. This function provides
 * a simplified interface for Swift code to configure GPIO pins.
 *
 * @param dev GPIO device pointer obtained from get_gpio_device()
 * @param pin Pin number to configure
 * @param dir Direction (GPIO_INPUT or GPIO_OUTPUT)
 * @param flags Additional configuration flags (pull-up/down, etc.)
 * @return 0 on success, negative error code on failure
 */
int configure_gpio_pin(const struct device *dev, uint8_t pin, gpio_flags_t dir, gpio_flags_t flags);
```

## src/Stubs.c
```c
// Copyright (c) 2025 Schubert Anselme <schubert@anselm.es>
// SPDX-Licence-Identifier: GPL-3.0

/**
 * @file Stubs.c
 * @brief Stub implementations for missing C library functions in Zephyr SDK.
 *
 * This file provides stub implementations for functions required by Embedded Swift
 * that are not available in the Zephyr SDK's C libraries. These stubs enable
 * Swift code to compile and run correctly on Zephyr RTOS by filling gaps in
 * the C runtime environment expected by Swift.
 *
 * Current implementations:
 * - posix_memalign: Memory allocation with alignment requirements
 * - getentropy: Random bytes generation (non-cryptographic implementation)
 */

#include <errno.h>
#include <stddef.h>
#include <stdint.h>
#include <stdlib.h>

/**
 * @brief Allocates memory with the specified alignment.
 *
 * This is a forward declaration for `aligned_alloc`, which allocates `size` bytes
 * of uninitialized storage whose alignment is specified by `alignment`.
 * This function is required for the stub implementation of `posix_memalign`.
 *
 * @param alignment The alignment value, which must be a power of two and a multiple of `sizeof(void *)`.
 * @param size      The size of the memory block to allocate.
 * @return          A pointer to the allocated memory, or `NULL` if the allocation fails.
 *
 * @note The actual implementation is provided by the Zephyr C library.
 */
void *aligned_alloc(size_t alignment, size_t size);

/**
 * @brief Generates a pseudo-random integer.
 *
 * This is a forward declaration for `rand`, which generates a pseudo-random integer.
 * It is used as a fallback for generating random bytes in the `getentropy` stub.
 *
 * @return A pseudo-random integer.
 */
int rand(void);

/**
 * @brief Allocates memory with the specified alignment using the `posix_memalign` interface.
 *
 * This function implements `posix_memalign` by forwarding the allocation request to `aligned_alloc`.
 * It is provided as a stub for environments where `posix_memalign` is not available, such as the Zephyr SDK.
 * Swift's memory allocator may call this function when it needs to allocate aligned memory blocks.
 *
 * @param[out] memptr    Pointer to the allocated memory block (output parameter).
 * @param[in]  alignment The alignment value, which must be a power of two and a multiple of `sizeof(void *)`.
 * @param[in]  size      The size of the memory block to allocate.
 *
 * @return 0 on successful allocation, or an error code (`errno`) on failure.
 */
int posix_memalign(void **memptr, const size_t alignment, const size_t size)
{
  // Attempt to allocate memory with the specified alignment and size
  void *p = aligned_alloc(alignment, size);

  if (p)
  {
    // Allocation succeeded, set the output pointer and return success
    *memptr = p;
    return 0;
  }

  // Allocation failed, return the error code stored in errno
  return errno;
}

/**
 * @brief Stub implementation of `getentropy`.
 *
 * This function fills a buffer with random bytes. Since Zephyr may not provide
 * a native `getentropy`, this stub uses `rand()` as a fallback.
 *
 * @warning This implementation is NOT cryptographically secure and should not be
 *          used for security-sensitive operations. It's provided only to satisfy
 *          Swift runtime dependencies in non-security-critical applications.
 *
 * @param buffer Pointer to the buffer to fill with random bytes.
 * @param length Number of bytes to generate (limited to 256 bytes per POSIX spec).
 *
 * @return 0 on success, -1 on failure with `errno` set to indicate the error.
 */
int getentropy(void *buffer, size_t length)
{
  // Validate input parameters:
  // - buffer must not be NULL
  // - length must not exceed 256 (POSIX specification limit)
  if (!buffer || length > 256) {
    errno = EINVAL;  // Set invalid argument error code
    return -1;
  }

  // Fill the buffer with pseudo-random bytes
  unsigned char *buf = (unsigned char *)buffer;
  for (size_t i = 0; i < length; i++) {
    // Generate a random byte (0-255) using rand()
    // Note: rand() is not suitable for cryptographic purposes
    buf[i] = rand() % 256;
  }

  return 0;  // Success
}
```
